DB 0C2h,0AFh,075h,081h,070h,0E4h,0F5h,0B1h,075h,0B2h,080h,07Fh,005h,0FEh,012h,0FBh 
DB 0A5h,075h,0B2h,00Ch,012h,0F5h,0A2h,075h,03Bh,0EFh,075h,03Ch,0FBh,085h,03Ch,082h 
DB 085h,03Bh,083h,0E4h,093h,064h,002h,060h,02Ah,075h,08Fh,001h,07Fh,0F4h,07Eh,001h 
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DB 000h,000h,000h,000h,000h,000h,000h,000h,000h,000h,000h,000h,000h,000h,000h,000h

/*
DB 0C2h, 0AFh, 075h, 081h, 070h, 0E4h, 0F5h, 0B1h, 075h, 0B2h, 080h, 07Fh, 005h, 0FEh, 012h, 0FBh
DB 0BCh, 075h, 0B2h, 00Ch, 012h, 0F5h, 0B9h, 075h, 03Bh, 0EFh, 075h, 03Ch, 0FBh, 085h, 03Ch, 082h
DB 085h, 03Bh, 083h, 0E4h, 093h, 064h, 002h, 060h, 02Ah, 075h, 08Fh, 001h, 07Fh, 0F4h, 07Eh, 001h
DB 012h, 0FBh, 0BCh, 075h, 0B2h, 008h, 07Fh, 005h, 07Eh, 000h, 012h, 0FBh, 0BCh, 075h, 0BCh, 002h
DB 07Fh, 0D0h, 07Eh, 007h, 012h, 0FBh, 0BCh, 075h, 0BCh, 003h, 075h, 0B2h, 00Ch, 012h, 0FAh, 0F1h
DB 012h, 0FCh, 01Ah, 002h, 0FCh, 042h, 0E5h, 042h, 064h, 0AAh, 060h, 003h, 002h, 0F1h, 02Dh, 0F5h
DB 042h, 075h, 02Fh, 011h, 075h, 030h, 008h, 0E5h, 024h, 0B4h, 005h, 014h, 005h, 030h, 0E5h, 030h
DB 0AEh, 02Fh, 070h, 002h, 005h, 02Fh, 014h, 0F5h, 082h, 08Eh, 083h, 074h, 005h, 0F0h, 080h, 012h
DB 005h, 030h, 0E5h, 030h, 0AEh, 02Fh, 070h, 002h, 005h, 02Fh, 014h, 0F5h, 082h, 08Eh, 083h, 074h
DB 006h, 0F0h, 005h, 030h, 0E5h, 030h, 0AEh, 02Fh, 070h, 002h, 005h, 02Fh, 014h, 0F5h, 082h, 08Eh
DB 083h, 074h, 049h, 0F0h, 075h, 03Bh, 00Ch, 075h, 03Ch, 000h, 085h, 03Ch, 082h, 085h, 03Bh, 083h
DB 0E4h, 093h, 0FFh, 005h, 030h, 0E5h, 030h, 0ACh, 02Fh, 070h, 002h, 005h, 02Fh, 014h, 0F5h, 082h
DB 08Ch, 083h, 0EFh, 0F0h, 075h, 03Bh, 00Ch, 075h, 03Ch, 001h, 085h, 03Ch, 082h, 085h, 03Bh, 083h
DB 0E4h, 093h, 0FFh, 005h, 030h, 0E5h, 030h, 0ACh, 02Fh, 070h, 002h, 005h, 02Fh, 014h, 0F5h, 082h
DB 08Ch, 083h, 0EFh, 0F0h, 075h, 03Bh, 00Ch, 075h, 03Ch, 002h, 085h, 03Ch, 082h, 085h, 03Bh, 083h
DB 0E4h, 093h, 0FFh, 005h, 030h, 0E5h, 030h, 0ACh, 02Fh, 070h, 002h, 005h, 02Fh, 014h, 0F5h, 082h
DB 08Ch, 083h, 0EFh, 0F0h, 075h, 03Bh, 00Ch, 075h, 03Ch, 003h, 085h, 03Ch, 082h, 085h, 03Bh, 083h
DB 0E4h, 093h, 0FFh, 005h, 030h, 0E5h, 030h, 0ACh, 02Fh, 070h, 002h, 005h, 02Fh, 014h, 0F5h, 082h
DB 08Ch, 083h, 0EFh, 0F0h, 053h, 09Bh, 0F0h, 075h, 09Bh, 008h, 002h, 0F2h, 05Fh, 075h, 02Fh, 011h
DB 075h, 030h, 008h, 0E5h, 024h, 0B4h, 005h, 014h, 005h, 030h, 0E5h, 030h, 0AEh, 02Fh, 070h, 002h
DB 005h, 02Fh, 014h, 0F5h, 082h, 08Eh, 083h, 074h, 005h, 0F0h, 080h, 012h, 005h, 030h, 0E5h, 030h
DB 0AEh, 02Fh, 070h, 002h, 005h, 02Fh, 014h, 0F5h, 082h, 08Eh, 083h, 074h, 006h, 0F0h, 005h, 030h
DB 0E5h, 030h, 0AEh, 02Fh, 070h, 002h, 005h, 02Fh, 014h, 0F5h, 082h, 08Eh, 083h, 074h, 072h, 0F0h
DB 0E5h, 021h, 0B4h, 001h, 008h, 085h, 031h, 03Bh, 085h, 032h, 03Ch, 080h, 006h, 075h, 03Bh, 0F0h
DB 075h, 03Ch, 000h, 0E5h, 03Ch, 045h, 03Bh, 070h, 05Ah, 005h, 030h, 0E5h, 030h, 0AEh, 02Fh, 070h
DB 002h, 005h, 02Fh, 014h, 0F5h, 082h, 08Eh, 083h, 074h, 002h, 0F0h, 075h, 03Bh, 0EFh, 075h, 03Ch
DB 0FCh, 085h, 03Ch, 082h, 085h, 03Bh, 083h, 0E4h, 093h, 0FFh, 005h, 030h, 0E5h, 030h, 0ACh, 02Fh
DB 070h, 002h, 005h, 02Fh, 014h, 0F5h, 082h, 08Ch, 083h, 0EFh, 0F0h, 075h, 03Bh, 0EFh, 075h, 03Ch
DB 0FDh, 085h, 03Ch, 082h, 085h, 03Bh, 083h, 0E4h, 093h, 0FFh, 005h, 030h, 0E5h, 030h, 0ACh, 02Fh
DB 070h, 002h, 005h, 02Fh, 014h, 0F5h, 082h, 08Ch, 083h, 0EFh, 0F0h, 075h, 03Bh, 000h, 075h, 03Ch
DB 003h, 080h, 057h, 085h, 03Ch, 082h, 085h, 03Bh, 083h, 0E4h, 093h, 0FFh, 005h, 030h, 0E5h, 030h
DB 0ACh, 02Fh, 070h, 002h, 005h, 02Fh, 014h, 0F5h, 082h, 08Ch, 083h, 0EFh, 0F0h, 012h, 0FCh, 004h
DB 085h, 03Ch, 082h, 085h, 03Bh, 083h, 0E4h, 093h, 0FFh, 005h, 030h, 0E5h, 030h, 0ACh, 02Fh, 070h
DB 002h, 005h, 02Fh, 014h, 0F5h, 082h, 08Ch, 083h, 0EFh, 0F0h, 012h, 0FCh, 004h, 085h, 03Ch, 082h
DB 085h, 03Bh, 083h, 0E4h, 093h, 0FFh, 005h, 030h, 0E5h, 030h, 0ACh, 02Fh, 070h, 002h, 005h, 02Fh
DB 014h, 0F5h, 082h, 08Ch, 083h, 0EFh, 0F0h, 012h, 0FCh, 004h, 085h, 03Ch, 082h, 085h, 03Bh, 083h
DB 0E4h, 093h, 0FFh, 005h, 030h, 0E5h, 030h, 0ACh, 02Fh, 070h, 002h, 005h, 02Fh, 014h, 0F5h, 082h
DB 08Ch, 083h, 0EFh, 0F0h, 0E5h, 024h, 0B4h, 005h, 00Ah, 053h, 09Bh, 0F0h, 043h, 09Bh, 006h, 043h
DB 097h, 004h, 022h, 012h, 0FCh, 004h, 085h, 03Ch, 082h, 085h, 03Bh, 083h, 0E4h, 093h, 0FFh, 005h
DB 030h, 0E5h, 030h, 0ACh, 02Fh, 070h, 002h, 005h, 02Fh, 014h, 0F5h, 082h, 08Ch, 083h, 0EFh, 0F0h
DB 012h, 0FCh, 004h, 085h, 03Ch, 082h, 085h, 03Bh, 083h, 0E4h, 093h, 085h, 030h, 082h, 085h, 02Fh
DB 083h, 0F0h, 053h, 09Bh, 0F0h, 043h, 09Bh, 008h, 043h, 097h, 004h, 0E4h, 0F5h, 0B1h, 0E5h, 097h
DB 020h, 0E2h, 0FBh, 0E4h, 0FFh, 053h, 09Bh, 0F0h, 043h, 09Bh, 008h, 075h, 02Fh, 011h, 075h, 030h
DB 008h, 012h, 0FCh, 004h, 085h, 03Ch, 082h, 085h, 03Bh, 083h, 0E4h, 093h, 0FEh, 005h, 030h, 0E5h
DB 030h, 0ACh, 02Fh, 070h, 002h, 005h, 02Fh, 012h, 0FBh, 0FDh, 085h, 03Ch, 082h, 085h, 03Bh, 083h
DB 0E4h, 093h, 0FEh, 005h, 030h, 0E5h, 030h, 0ACh, 02Fh, 070h, 002h, 005h, 02Fh, 012h, 0FBh, 0FDh
DB 085h, 03Ch, 082h, 085h, 03Bh, 083h, 0E4h, 093h, 0FEh, 005h, 030h, 0E5h, 030h, 0ACh, 02Fh, 070h
DB 002h, 005h, 02Fh, 012h, 0FBh, 0FDh, 085h, 03Ch, 082h, 085h, 03Bh, 083h, 0E4h, 093h, 0FEh, 005h
DB 030h, 0E5h, 030h, 0ACh, 02Fh, 070h, 002h, 005h, 02Fh, 012h, 0FBh, 0FDh, 085h, 03Ch, 082h, 085h
DB 03Bh, 083h, 0E4h, 093h, 0FEh, 005h, 030h, 0E5h, 030h, 0ACh, 02Fh, 070h, 002h, 005h, 02Fh, 012h
DB 0FBh, 0FDh, 0ACh, 03Bh, 0ADh, 03Ch, 0BCh, 0EFh, 034h, 0BDh, 0FBh, 031h, 005h, 030h, 0E5h, 030h
DB 0ACh, 02Fh, 070h, 002h, 005h, 02Fh, 014h, 0F5h, 082h, 08Ch, 083h, 0E4h, 0F0h, 005h, 030h, 0E5h
DB 030h, 0ACh, 02Fh, 070h, 002h, 005h, 02Fh, 014h, 0F5h, 082h, 08Ch, 083h, 0E4h, 0F0h, 085h, 030h
DB 082h, 085h, 02Fh, 083h, 0F0h, 075h, 03Bh, 0EFh, 075h, 03Ch, 0FDh, 080h, 03Bh, 085h, 03Ch, 082h
DB 085h, 03Bh, 083h, 0E4h, 093h, 0FEh, 005h, 030h, 0E5h, 030h, 0ACh, 02Fh, 070h, 002h, 005h, 02Fh
DB 012h, 0FBh, 0FDh, 085h, 03Ch, 082h, 085h, 03Bh, 083h, 0E4h, 093h, 0FEh, 005h, 030h, 0E5h, 030h
DB 0ACh, 02Fh, 070h, 002h, 005h, 02Fh, 012h, 0FBh, 0FDh, 085h, 03Ch, 082h, 085h, 03Bh, 083h, 0E4h
DB 093h, 085h, 030h, 082h, 085h, 02Fh, 083h, 0F0h, 043h, 097h, 004h, 0E4h, 0F5h, 0B1h, 0E5h, 097h
DB 020h, 0E2h, 0FBh, 00Fh, 0EFh, 0F4h, 060h, 003h, 002h, 0F2h, 0A5h, 053h, 09Bh, 0F0h, 043h, 09Bh
DB 002h, 075h, 02Fh, 011h, 075h, 030h, 008h, 012h, 0FCh, 004h, 085h, 03Ch, 082h, 085h, 03Bh, 083h
DB 0E4h, 093h, 0FFh, 005h, 030h, 0E5h, 030h, 0ACh, 02Fh, 070h, 002h, 005h, 02Fh, 014h, 0F5h, 082h
DB 08Ch, 083h, 0EFh, 0F0h, 012h, 0FCh, 004h, 085h, 03Ch, 082h, 085h, 03Bh, 083h, 0E4h, 093h, 085h
DB 030h, 082h, 085h, 02Fh, 083h, 0F0h, 043h, 097h, 004h, 0E4h, 0F5h, 0B1h, 0E5h, 097h, 020h, 0E2h
DB 0FBh, 012h, 0FCh, 004h, 085h, 03Bh, 031h, 085h, 03Ch, 032h, 022h, 0E4h, 0F5h, 042h, 012h, 0FBh
DB 0ECh, 0E5h, 023h, 024h, 0BBh, 070h, 003h, 002h, 0F5h, 029h, 024h, 0FCh, 070h, 003h, 002h, 0F5h
DB 0A9h, 024h, 0F4h, 070h, 003h, 002h, 0F5h, 054h, 024h, 0FEh, 060h, 02Bh, 024h, 0FDh, 070h, 003h
DB 002h, 0F5h, 068h, 024h, 0F1h, 070h, 003h, 002h, 0F5h, 083h, 024h, 0F2h, 060h, 02Bh, 024h, 025h
DB 060h, 003h, 002h, 0F5h, 0ACh, 0E4h, 0F5h, 031h, 0F5h, 032h, 0E5h, 032h, 045h, 025h, 0F5h, 031h
DB 0E5h, 024h, 0F5h, 032h, 002h, 0F5h, 0ACh, 0E4h, 0F5h, 033h, 0F5h, 034h, 0E5h, 034h, 045h, 025h
DB 0F5h, 033h, 0E5h, 024h, 0F5h, 034h, 002h, 0F5h, 0ACh, 0D3h, 0E4h, 095h, 034h, 074h, 0F0h, 095h
DB 033h, 050h, 003h, 002h, 0F5h, 0ACh, 0E5h, 034h, 045h, 033h, 070h, 01Ah, 0ADh, 025h, 07Fh, 0FCh
DB 07Eh, 0EFh, 012h, 0FBh, 023h, 0ADh, 026h, 07Fh, 0FDh, 07Eh, 0EFh, 012h, 0FBh, 023h, 075h, 033h
DB 000h, 075h, 034h, 003h, 080h, 024h, 0ADh, 024h, 0AFh, 034h, 0AEh, 033h, 012h, 0FBh, 023h, 012h
DB 0FCh, 025h, 0ADh, 025h, 0AFh, 034h, 0AEh, 033h, 012h, 0FBh, 023h, 012h, 0FCh, 025h, 0ADh, 026h
DB 0AFh, 034h, 0AEh, 033h, 012h, 0FBh, 023h, 012h, 0FCh, 025h, 0ADh, 027h, 0AFh, 034h, 0AEh, 033h
DB 012h, 0FBh, 023h, 0E5h, 022h, 0B4h, 005h, 003h, 002h, 0F5h, 0ACh, 0E5h, 022h, 064h, 006h, 060h
DB 003h, 002h, 0F5h, 0ACh, 012h, 0FCh, 025h, 0ADh, 028h, 0AFh, 034h, 0AEh, 033h, 012h, 0FBh, 023h
DB 012h, 0FCh, 025h, 0ADh, 029h, 0AFh, 034h, 0AEh, 033h, 012h, 0FBh, 023h, 0E4h, 0F5h, 00Ah, 012h
DB 0FBh, 0ECh, 0E4h, 0F5h, 00Bh, 012h, 0FCh, 025h, 074h, 022h, 025h, 00Bh, 0F8h, 0E6h, 0FDh, 0AFh
DB 034h, 0AEh, 033h, 012h, 0FBh, 023h, 005h, 00Bh, 0E5h, 00Bh, 0C3h, 094h, 008h, 040h, 0E6h, 005h
DB 00Ah, 0E5h, 00Ah, 0C3h, 094h, 0FFh, 040h, 0D7h, 012h, 0FBh, 0ECh, 012h, 0FCh, 025h, 0ADh, 022h
DB 0AFh, 034h, 0AEh, 033h, 012h, 0FBh, 023h, 012h, 0FCh, 025h, 0ADh, 023h, 0AFh, 034h, 0AEh, 033h
DB 012h, 0FBh, 023h, 012h, 0FCh, 025h, 002h, 0F5h, 0ACh, 075h, 00Ah, 078h, 0E5h, 00Ah, 014h, 0FFh
DB 012h, 0FBh, 04Eh, 015h, 00Ah, 0E5h, 00Ah, 0D3h, 094h, 000h, 050h, 0F0h, 07Dh, 0F0h, 07Fh, 001h
DB 07Eh, 000h, 012h, 0FBh, 023h, 0E4h, 0FDh, 07Fh, 002h, 0FEh, 012h, 0FBh, 023h, 07Dh, 002h, 0E4h
DB 0FFh, 0FEh, 080h, 00Ch, 053h, 09Bh, 0F0h, 043h, 097h, 004h, 07Dh, 002h, 07Fh, 0FBh, 07Eh, 0EFh
DB 012h, 0FBh, 023h, 075h, 021h, 001h, 080h, 044h, 0E4h, 0F5h, 091h, 0F5h, 092h, 0F5h, 093h, 0F5h
DB 094h, 0F5h, 095h, 0F5h, 096h, 0F5h, 0B1h, 07Fh, 0D0h, 07Eh, 007h, 012h, 0FBh, 0BCh, 012h, 0FCh
DB 045h, 080h, 029h, 0ADh, 024h, 07Fh, 0F7h, 07Eh, 0EFh, 012h, 0FBh, 023h, 0ADh, 025h, 07Fh, 0F8h
DB 07Eh, 0EFh, 012h, 0FBh, 023h, 0ADh, 026h, 07Fh, 0F9h, 07Eh, 0EFh, 012h, 0FBh, 023h, 0ADh, 027h
DB 07Fh, 0FAh, 07Eh, 0EFh, 012h, 0FBh, 023h, 080h, 003h, 075h, 042h, 0AAh, 053h, 09Bh, 0F0h, 043h
DB 097h, 004h, 053h, 092h, 0AFh, 043h, 097h, 001h, 022h, 0C2h, 004h, 075h, 008h, 096h, 0E4h, 0F5h
DB 0B1h, 053h, 0E9h, 0FCh, 053h, 0E1h, 0FCh, 07Fh, 00Ah, 0FEh, 012h, 0FBh, 0BCh, 030h, 081h, 003h
DB 002h, 0F7h, 038h, 020h, 080h, 003h, 002h, 0F7h, 038h, 0D2h, 004h, 0D5h, 008h, 0E0h, 075h, 00Ch
DB 014h, 053h, 0E9h, 0FCh, 053h, 0E1h, 0FCh, 0C2h, 081h, 043h, 0E1h, 002h, 043h, 0E9h, 001h, 07Fh
DB 001h, 07Eh, 000h, 012h, 0FBh, 0BCh, 053h, 0E9h, 0FCh, 053h, 0E1h, 0FCh, 043h, 0E9h, 002h, 07Fh
DB 00Ah, 07Eh, 000h, 012h, 0FBh, 0BCh, 075h, 009h, 064h, 0E4h, 0F5h, 0B1h, 030h, 081h, 003h, 020h
DB 080h, 004h, 0C2h, 004h, 080h, 003h, 0D5h, 009h, 0F0h, 020h, 004h, 003h, 002h, 0F6h, 0E0h, 053h
DB 0E9h, 0FCh, 053h, 0E1h, 0FCh, 0C2h, 081h, 043h, 0E1h, 002h, 043h, 0E9h, 001h, 07Fh, 001h, 07Eh
DB 000h, 012h, 0FBh, 0BCh, 053h, 0E9h, 0FCh, 053h, 0E1h, 0FCh, 043h, 0E9h, 002h, 0C2h, 080h, 043h
DB 0E1h, 001h, 07Fh, 00Ah, 07Eh, 000h, 012h, 0FBh, 0BCh, 075h, 009h, 064h, 0E4h, 0F5h, 0B1h, 020h
DB 081h, 003h, 030h, 080h, 004h, 0C2h, 004h, 080h, 003h, 0D5h, 009h, 0F0h, 020h, 004h, 003h, 002h
DB 0F6h, 0E0h, 053h, 0E9h, 0FCh, 053h, 0E1h, 0FCh, 0C2h, 081h, 043h, 0E1h, 002h, 043h, 0E9h, 001h
DB 07Fh, 001h, 07Eh, 000h, 012h, 0FBh, 0BCh, 053h, 0E9h, 0FCh, 053h, 0E1h, 0FCh, 07Fh, 00Ah, 07Eh
DB 000h, 012h, 0FBh, 0BCh, 075h, 009h, 064h, 0E4h, 0F5h, 0B1h, 020h, 081h, 003h, 020h, 080h, 004h
DB 0C2h, 004h, 080h, 003h, 0D5h, 009h, 0F0h, 030h, 004h, 046h, 053h, 0E9h, 0FCh, 053h, 0E1h, 0FCh
DB 0C2h, 081h, 043h, 0E1h, 002h, 043h, 0E9h, 001h, 07Fh, 001h, 07Eh, 000h, 012h, 0FBh, 0BCh, 053h
DB 0E9h, 0FCh, 053h, 0E1h, 0FCh, 0C2h, 081h, 043h, 0E1h, 002h, 07Fh, 00Ah, 07Eh, 000h, 012h, 0FBh
DB 0BCh, 075h, 009h, 064h, 0E4h, 0F5h, 0B1h, 020h, 081h, 003h, 020h, 080h, 004h, 0C2h, 004h, 080h
DB 003h, 0D5h, 009h, 0F0h, 030h, 004h, 009h, 015h, 00Ch, 0E5h, 00Ch, 060h, 003h, 002h, 0F5h, 0E1h
DB 030h, 004h, 057h, 053h, 0E9h, 0FCh, 053h, 0E1h, 0FCh, 075h, 009h, 003h, 075h, 03Bh, 0EFh, 075h
DB 03Ch, 0FBh, 085h, 03Ch, 082h, 085h, 03Bh, 083h, 0E4h, 093h, 0B4h, 002h, 00Bh, 0E4h, 0F5h, 0B1h
DB 07Fh, 077h, 012h, 0FBh, 04Eh, 0D5h, 009h, 0E4h, 043h, 0E9h, 002h, 053h, 0E1h, 0FDh, 030h, 004h
DB 009h, 0C2h, 004h, 0C2h, 080h, 043h, 0E1h, 001h, 080h, 005h, 0D2h, 004h, 053h, 0E1h, 0FEh, 075h
DB 00Ah, 0C3h, 075h, 00Bh, 050h, 0E5h, 00Bh, 045h, 00Ah, 060h, 0DDh, 0E4h, 0F5h, 0B1h, 0E5h, 00Bh
DB 015h, 00Bh, 070h, 0F1h, 015h, 00Ah, 080h, 0EDh, 0C2h, 004h, 053h, 0E9h, 0FCh, 053h, 0E1h, 0FCh
DB 022h, 005h, 001h, 009h, 006h, 0A1h, 001h, 085h, 001h, 005h, 007h, 019h, 0E0h, 029h, 0E7h, 015h
DB 000h, 025h, 001h, 075h, 001h, 095h, 008h, 081h, 002h, 095h, 006h, 075h, 008h, 015h, 000h, 026h
DB 0FFh, 000h, 005h, 007h, 019h, 000h, 02Ah, 0FFh, 000h, 081h, 000h, 0C0h, 006h, 000h, 0FFh, 009h
DB 001h, 0A1h, 001h, 085h, 005h, 015h, 000h, 025h, 0FFh, 019h, 001h, 029h, 005h, 075h, 008h, 095h
DB 005h, 0B1h, 002h, 0C0h, 006h, 000h, 0FFh, 009h, 001h, 0A1h, 001h, 085h, 006h, 015h, 000h, 025h
DB 0FFh, 019h, 001h, 029h, 002h, 075h, 008h, 096h, 001h, 008h, 0B1h, 002h, 0C0h, 012h, 001h, 010h
DB 001h, 000h, 000h, 000h, 008h, 003h, 006h, 020h, 010h, 000h, 001h, 000h, 000h, 000h, 001h, 009h
DB 002h, 01Bh, 000h, 001h, 001h, 000h, 080h, 032h, 009h, 004h, 000h, 000h, 000h, 003h, 000h, 000h
DB 000h, 009h, 021h, 011h, 001h, 000h, 001h, 022h, 05Ch, 000h, 0FFh, 0FCh, 035h, 0FFh, 0FBh, 09Bh
DB 0FFh, 0FCh, 03Ch, 0FFh, 0F7h, 0F4h, 0FFh, 0F0h, 056h, 0FFh, 0F3h, 0FBh, 0FFh, 0FCh, 00Dh, 000h
DB 005h, 001h, 000h, 009h, 002h, 080h, 006h, 003h, 081h, 006h, 003h, 0A1h, 001h, 004h, 021h, 009h
DB 005h, 021h, 00Ah, 006h, 0E5h, 025h, 064h, 001h, 070h, 02Eh, 0F5h, 035h, 075h, 036h, 012h, 0E5h
DB 029h, 0F5h, 02Dh, 0E5h, 028h, 0F5h, 02Eh, 0C3h, 0E5h, 02Eh, 095h, 036h, 0E5h, 02Dh, 095h, 035h
DB 050h, 006h, 0AEh, 02Dh, 0AFh, 02Eh, 080h, 004h, 0AEh, 035h, 0AFh, 036h, 08Eh, 035h, 08Fh, 036h
DB 075h, 03Bh, 0F7h, 075h, 03Ch, 09Dh, 080h, 06Fh, 0E5h, 025h, 064h, 002h, 070h, 02Eh, 0F5h, 035h
DB 075h, 036h, 01Bh, 0E5h, 029h, 0F5h, 02Dh, 0E5h, 028h, 0F5h, 02Eh, 0C3h, 0E5h, 02Eh, 095h, 036h
DB 0E5h, 02Dh, 095h, 035h, 050h, 006h, 0AEh, 02Dh, 0AFh, 02Eh, 080h, 004h, 0AEh, 035h, 0AFh, 036h
DB 08Eh, 035h, 08Fh, 036h, 075h, 03Bh, 0F7h, 075h, 03Ch, 0AFh, 080h, 03Bh, 0E5h, 025h, 064h, 022h
DB 070h, 032h, 0E5h, 026h, 070h, 02Eh, 075h, 03Bh, 0F7h, 075h, 03Ch, 041h, 0F5h, 035h, 075h, 036h
DB 05Ch, 0E5h, 029h, 0F5h, 02Dh, 0E5h, 028h, 0F5h, 02Eh, 0C3h, 0E5h, 02Eh, 095h, 036h, 0E5h, 02Dh
DB 095h, 035h, 050h, 006h, 0AEh, 02Dh, 0AFh, 02Eh, 080h, 004h, 0AEh, 035h, 0AFh, 036h, 08Eh, 035h
DB 08Fh, 036h, 080h, 003h, 002h, 0FCh, 035h, 012h, 0F9h, 09Ch, 043h, 097h, 004h, 022h, 078h, 07Fh
DB 0E4h, 0F6h, 0D8h, 0FDh, 075h, 081h, 043h, 002h, 0F8h, 0E5h, 002h, 0F0h, 000h, 0E4h, 093h, 0A3h
DB 0F8h, 0E4h, 093h, 0A3h, 040h, 003h, 0F6h, 080h, 001h, 0F2h, 008h, 0DFh, 0F4h, 080h, 029h, 0E4h
DB 093h, 0A3h, 0F8h, 054h, 007h, 024h, 00Ch, 0C8h, 0C3h, 033h, 0C4h, 054h, 00Fh, 044h, 020h, 0C8h
DB 083h, 040h, 004h, 0F4h, 056h, 080h, 001h, 046h, 0F6h, 0DFh, 0E4h, 080h, 00Bh, 001h, 002h, 004h
DB 008h, 010h, 020h, 040h, 080h, 090h, 0FCh, 04Eh, 0E4h, 07Eh, 001h, 093h, 060h, 0BCh, 0A3h, 0FFh
DB 054h, 03Fh, 030h, 0E5h, 009h, 054h, 01Fh, 0FEh, 0E4h, 093h, 0A3h, 060h, 001h, 00Eh, 0CFh, 054h
DB 0C0h, 025h, 0E0h, 060h, 0A8h, 040h, 0B8h, 0E4h, 093h, 0A3h, 0FAh, 0E4h, 093h, 0A3h, 0F8h, 0E4h
DB 093h, 0A3h, 0C8h, 0C5h, 082h, 0C8h, 0CAh, 0C5h, 083h, 0CAh, 0F0h, 0A3h, 0C8h, 0C5h, 082h, 0C8h
DB 0CAh, 0C5h, 083h, 0CAh, 0DFh, 0E9h, 0DEh, 0E7h, 080h, 0BEh, 085h, 092h, 037h, 0E5h, 037h, 060h
DB 04Bh, 053h, 092h, 0E7h, 053h, 092h, 09Fh, 0E5h, 037h, 030h, 0E7h, 005h, 053h, 092h, 07Fh, 080h
DB 03Bh, 0E5h, 037h, 030h, 0E4h, 005h, 012h, 0FAh, 065h, 080h, 031h, 0E5h, 037h, 030h, 0E2h, 005h
DB 053h, 092h, 0FBh, 080h, 027h, 0E5h, 037h, 030h, 0E1h, 005h, 053h, 092h, 0FDh, 080h, 01Dh, 0E5h
DB 037h, 030h, 0E0h, 018h, 053h, 092h, 0FEh, 043h, 091h, 020h, 000h, 000h, 000h, 000h, 000h, 000h
DB 053h, 091h, 0DFh, 012h, 0FBh, 0D8h, 053h, 092h, 0AFh, 043h, 097h, 001h, 085h, 093h, 038h, 0E5h
DB 038h, 060h, 018h, 030h, 0E4h, 00Ah, 053h, 093h, 0EFh, 053h, 092h, 0AFh, 043h, 097h, 001h, 022h
DB 0E5h, 038h, 030h, 0E0h, 006h, 053h, 093h, 0FEh, 012h, 0FBh, 075h, 022h, 0E5h, 036h, 045h, 035h
DB 070h, 007h, 075h, 043h, 002h, 053h, 09Bh, 0F0h, 022h, 0D3h, 0E5h, 036h, 094h, 008h, 0E5h, 035h
DB 094h, 000h, 040h, 01Fh, 075h, 043h, 001h, 074h, 0F8h, 025h, 036h, 0F5h, 036h, 074h, 0FFh, 035h
DB 035h, 0F5h, 035h, 012h, 0FAh, 0B9h, 074h, 008h, 025h, 03Ch, 0F5h, 03Ch, 0E4h, 035h, 03Bh, 0F5h
DB 03Bh, 080h, 013h, 0E5h, 036h, 064h, 008h, 045h, 035h, 070h, 012h, 075h, 043h, 002h, 012h, 0FAh
DB 0B9h, 0E4h, 0F5h, 035h, 0F5h, 036h, 053h, 09Bh, 0F0h, 043h, 09Bh, 008h, 022h, 075h, 043h, 002h
DB 0ADh, 036h, 012h, 0FAh, 0BBh, 053h, 09Bh, 0F0h, 0E5h, 036h, 042h, 09Bh, 0E4h, 0F5h, 035h, 0F5h
DB 036h, 022h, 075h, 02Fh, 011h, 075h, 030h, 000h, 085h, 030h, 082h, 085h, 02Fh, 083h, 0E0h, 0F5h
DB 022h, 0A3h, 0E0h, 0F5h, 023h, 085h, 030h, 082h, 085h, 02Fh, 083h, 0A3h, 0A3h, 0E0h, 0F5h, 024h
DB 085h, 030h, 082h, 085h, 02Fh, 083h, 0A3h, 0A3h, 0A3h, 0E0h, 0F5h, 025h, 0E5h, 030h, 024h, 004h
DB 0F5h, 082h, 0E4h, 035h, 02Fh, 0F5h, 083h, 0E0h, 0F5h, 026h, 0E5h, 030h, 024h, 005h, 0F5h, 082h
DB 0E4h, 035h, 02Fh, 0F5h, 083h, 0E0h, 0F5h, 027h, 0E5h, 030h, 024h, 006h, 0F5h, 082h, 0E4h, 035h
DB 02Fh, 0F5h, 083h, 0E0h, 0F5h, 028h, 0E5h, 030h, 024h, 007h, 0F5h, 082h, 0E4h, 035h, 02Fh, 0F5h
DB 083h, 0E0h, 0F5h, 029h, 022h, 075h, 008h, 0F7h, 075h, 009h, 0DFh, 012h, 0FAh, 002h, 0E4h, 0F5h
DB 041h, 085h, 009h, 082h, 085h, 008h, 083h, 0E4h, 093h, 0B5h, 022h, 00Dh, 074h, 001h, 093h, 0B5h
DB 023h, 007h, 074h, 002h, 093h, 0F5h, 041h, 080h, 016h, 074h, 003h, 025h, 009h, 0F5h, 009h, 0E4h
DB 035h, 008h, 0F5h, 008h, 0C3h, 0E5h, 009h, 094h, 0F4h, 0E5h, 008h, 094h, 0F7h, 040h, 0D2h, 0E5h
DB 041h, 075h, 0F0h, 003h, 0A4h, 024h, 0CAh, 0F5h, 082h, 0E4h, 034h, 0F7h, 0F5h, 083h, 074h, 001h
DB 093h, 0FAh, 074h, 002h, 093h, 0F9h, 002h, 0FCh, 048h, 07Dh, 008h, 0AFh, 03Ch, 0AEh, 03Bh, 08Eh
DB 00Ah, 08Fh, 00Bh, 075h, 02Fh, 011h, 075h, 030h, 008h, 0E4h, 0FFh, 0EFh, 0C3h, 09Dh, 050h, 020h
DB 085h, 00Bh, 082h, 085h, 00Ah, 083h, 0E4h, 093h, 0FEh, 0E5h, 030h, 02Fh, 0F5h, 082h, 0E4h, 035h
DB 02Fh, 0F5h, 083h, 0EEh, 0F0h, 005h, 00Bh, 0E5h, 00Bh, 070h, 002h, 005h, 00Ah, 00Fh, 080h, 0DBh
DB 022h, 0E4h, 0F5h, 080h, 0F5h, 0E9h, 0F5h, 0E1h, 0F5h, 090h, 0F5h, 0EAh, 0F5h, 0E2h, 0F5h, 098h
DB 0F5h, 0EBh, 0F5h, 0E3h, 0F5h, 0A0h, 0F5h, 0ECh, 0F5h, 0E4h, 0F5h, 0B0h, 0F5h, 0EDh, 0F5h, 0E5h
DB 0F5h, 088h, 0F5h, 0EEh, 0F5h, 0E6h, 0F5h, 0C0h, 0F5h, 0EFh, 0F5h, 0E7h, 0F5h, 0F8h, 0F5h, 0D9h
DB 0F5h, 0D1h, 022h, 0ABh, 007h, 0AAh, 006h, 0E4h, 0F5h, 0B1h, 08Ah, 0F7h, 08Bh, 0FBh, 08Dh, 0FCh
DB 075h, 0F2h, 06Eh, 075h, 0F3h, 005h, 075h, 0F4h, 00Ah, 075h, 0F5h, 009h, 075h, 0F6h, 006h, 000h
DB 000h, 000h, 000h, 0F5h, 0F2h, 0F5h, 0F3h, 0F5h, 0F4h, 0F5h, 0F5h, 0F5h, 0F6h, 022h, 0E4h, 0F5h
DB 0B1h, 0EFh, 025h, 0E0h, 0F5h, 0F7h, 075h, 0F2h, 0E6h, 075h, 0F3h, 005h, 075h, 0F4h, 00Ah, 075h
DB 0F5h, 009h, 075h, 0F6h, 006h, 000h, 000h, 000h, 000h, 0E4h, 0F5h, 0F2h, 0F5h, 0F3h, 0F5h, 0F4h
DB 0F5h, 0F5h, 0F5h, 0F6h, 022h, 0E5h, 043h, 0B4h, 001h, 008h, 012h, 0F9h, 09Ch, 043h, 097h, 004h
DB 080h, 012h, 0E5h, 043h, 0B4h, 002h, 00Ah, 053h, 092h, 0AFh, 043h, 097h, 001h, 043h, 097h, 008h
DB 022h, 043h, 097h, 008h, 053h, 092h, 0AFh, 043h, 097h, 001h, 022h, 0E4h, 0F5h, 043h, 053h, 09Bh
DB 0F0h, 043h, 097h, 002h, 043h, 097h, 004h, 0E5h, 093h, 030h, 0E0h, 0FBh, 053h, 093h, 0FEh, 085h
DB 024h, 096h, 043h, 097h, 008h, 053h, 092h, 0AFh, 043h, 097h, 001h, 022h, 000h, 0EFh, 060h, 00Bh
DB 01Fh, 000h, 000h, 000h, 000h, 000h, 000h, 000h, 000h, 080h, 0F2h, 0EEh, 060h, 005h, 01Eh, 07Fh
DB 0FFh, 080h, 0EAh, 000h, 000h, 000h, 000h, 022h, 043h, 091h, 0C0h, 0E4h, 0F5h, 092h, 0F5h, 093h
DB 075h, 094h, 057h, 075h, 095h, 011h, 0F5h, 096h, 043h, 0A9h, 001h, 022h, 053h, 092h, 0AFh, 043h
DB 097h, 001h, 0E5h, 093h, 030h, 0E4h, 0FBh, 053h, 093h, 0EFh, 002h, 0FAh, 002h, 014h, 0F5h, 082h
DB 08Ch, 083h, 0EEh, 0F0h, 005h, 03Ch, 0E5h, 03Ch, 070h, 002h, 005h, 03Bh, 022h, 0AFh, 025h, 08Fh
DB 02Ch, 08Fh, 03Dh, 053h, 09Bh, 0F0h, 043h, 097h, 004h, 022h, 012h, 0FBh, 0D8h, 0E4h, 0F5h, 0B1h
DB 012h, 0F9h, 02Ah, 080h, 0F8h, 005h, 034h, 0E5h, 034h, 070h, 002h, 005h, 033h, 022h, 053h, 09Bh
DB 0F0h, 043h, 097h, 004h, 022h, 043h, 097h, 008h, 043h, 097h, 002h, 022h, 0E4h, 0F5h, 043h, 002h
DB 0FCh, 02Eh, 002h, 0EFh, 0FBh, 002h, 000h, 000h, 08Ah, 083h, 089h, 082h, 0E4h, 073h, 000h, 000h
DB 000h, 000h, 000h, 000h, 000h, 000h, 000h, 000h, 000h, 000h, 000h, 000h, 000h, 000h, 000h, 000h
DB 000h, 000h, 000h, 000h, 000h, 000h, 000h, 000h, 000h, 000h, 000h, 000h, 000h, 000h, 000h, 000h
DB 000h, 000h, 000h, 000h, 000h, 000h, 000h, 000h, 000h, 000h, 000h, 000h, 000h, 000h, 000h, 000h
DB 000h, 000h, 000h, 000h, 000h, 000h, 000h, 000h, 000h, 000h, 000h, 000h, 000h, 000h, 000h, 000h
DB 000h, 000h, 000h, 000h, 000h, 000h, 000h, 000h, 000h, 000h, 000h, 000h, 000h, 000h, 000h, 000h
DB 000h, 000h, 000h, 000h, 000h, 000h, 000h, 000h, 000h, 000h, 000h, 000h, 000h, 000h, 000h, 000h
DB 000h, 000h, 000h, 000h, 000h, 000h, 000h, 000h, 000h, 000h, 000h, 000h, 000h, 000h, 000h, 000h
DB 000h, 000h, 000h, 000h, 000h, 000h, 000h, 000h, 000h, 000h, 000h, 000h, 000h, 000h, 000h, 000h
DB 000h, 000h, 000h, 000h, 000h, 000h, 000h, 000h, 000h, 000h, 000h, 000h, 000h, 000h, 000h, 000h
DB 000h, 000h, 000h, 000h, 000h, 000h, 000h, 000h, 000h, 000h, 000h, 000h, 000h, 000h, 000h, 000h
DB 000h, 000h, 000h, 000h, 000h, 000h, 000h, 000h, 000h, 000h, 000h, 000h, 000h, 000h, 000h, 000h
DB 000h, 000h, 000h, 000h, 000h, 000h, 000h, 000h, 000h, 000h, 000h, 000h, 000h, 000h, 000h, 000h
DB 000h, 000h, 000h, 000h, 000h, 000h, 000h, 000h, 000h, 000h, 000h, 000h, 000h, 000h, 000h, 000h
DB 000h, 000h, 000h, 000h, 000h, 000h, 000h, 000h, 000h, 000h, 000h, 000h, 000h, 000h, 000h, 000h
DB 000h, 000h, 000h, 000h, 000h, 000h, 000h, 000h, 000h, 000h, 000h, 000h, 000h, 000h, 000h, 000h
DB 000h, 000h, 000h, 000h, 000h, 000h, 000h, 000h, 000h, 000h, 000h, 000h, 000h, 000h, 000h, 000h
DB 000h, 000h, 000h, 000h, 000h, 000h, 000h, 000h, 000h, 000h, 000h, 000h, 000h, 000h, 000h, 000h
DB 000h, 000h, 000h, 000h, 000h, 000h, 000h, 000h, 000h, 000h, 000h, 000h, 000h, 000h, 000h, 000h
DB 000h, 000h, 000h, 000h, 000h, 000h, 000h, 000h, 000h, 000h, 000h, 000h, 000h, 000h, 000h, 000h
DB 000h, 000h, 000h, 000h, 000h, 000h, 000h, 000h, 000h, 000h, 000h, 000h, 000h, 000h, 000h, 000h
DB 000h, 000h, 000h, 000h, 000h, 000h, 000h, 000h, 000h, 000h, 000h, 000h, 000h, 000h, 000h, 000h
DB 000h, 000h, 000h, 000h, 000h, 000h, 000h, 000h, 000h, 000h, 000h, 000h, 000h, 000h, 000h, 000h
DB 000h, 000h, 000h, 000h, 000h, 000h, 000h, 000h, 000h, 000h, 000h, 000h, 000h, 000h, 000h, 000h
DB 000h, 000h, 000h, 000h, 000h, 000h, 000h, 000h, 000h, 000h, 000h, 000h, 000h, 000h, 000h, 000h
DB 000h, 000h, 000h, 000h, 000h, 000h, 000h, 000h, 000h, 000h, 000h, 000h, 000h, 000h, 000h, 000h
DB 000h, 000h, 000h, 000h, 000h, 000h, 000h, 000h, 000h, 000h, 000h, 000h, 000h, 000h, 000h, 000h
DB 000h, 000h, 000h, 000h, 000h, 000h, 000h, 000h, 000h, 000h, 000h, 000h, 000h, 000h, 000h, 000h
DB 000h, 000h, 000h, 000h, 000h, 000h, 000h, 000h, 000h, 000h, 000h, 000h, 000h, 000h, 000h, 000h
DB 000h, 000h, 000h, 000h, 000h, 000h, 000h, 000h, 000h, 000h, 000h, 000h, 000h, 000h, 000h, 000h
DB 000h, 000h, 000h, 000h, 000h, 000h, 000h, 000h, 000h, 000h, 000h, 000h, 000h, 000h, 000h, 000h
DB 000h, 000h, 000h, 000h, 000h, 000h, 000h, 000h, 000h, 000h, 000h, 000h, 000h, 000h, 000h, 000h
DB 000h, 000h, 000h, 000h, 000h, 000h, 000h, 000h, 000h, 000h, 000h, 000h, 000h, 000h, 000h, 000h
DB 000h, 000h, 000h, 000h, 000h, 000h, 000h, 000h, 000h, 000h, 000h, 000h, 000h, 000h, 000h, 000h
DB 000h, 000h, 000h, 000h, 000h, 000h, 000h, 000h, 000h, 000h, 000h, 000h, 000h, 000h, 000h, 000h
DB 000h, 000h, 000h, 000h, 000h, 000h, 000h, 000h, 000h, 000h, 000h, 000h, 000h, 000h, 000h, 000h
DB 000h, 000h, 000h, 000h, 000h, 000h, 000h, 000h, 000h, 000h, 000h, 000h, 000h, 000h, 000h, 000h
DB 000h, 000h, 000h, 000h, 000h, 000h, 000h, 000h, 000h, 000h, 000h, 000h, 000h, 000h, 000h, 000h
DB 000h, 000h, 000h, 000h, 000h, 000h, 000h, 000h, 000h, 000h, 000h, 000h, 000h, 000h, 000h, 000h
DB 000h, 000h, 000h, 000h, 000h, 000h, 000h, 000h, 000h, 000h, 000h, 000h, 000h, 000h, 000h, 000h
DB 000h, 000h, 000h, 000h, 000h, 000h, 000h, 000h, 000h, 000h, 000h, 000h, 000h, 000h, 000h, 000h
DB 000h, 000h, 000h, 000h, 000h, 000h, 000h, 000h, 000h, 000h, 000h, 000h, 000h, 000h, 000h, 000h
DB 000h, 000h, 000h, 000h, 000h, 000h, 000h, 000h, 000h, 000h, 000h, 000h, 000h, 000h, 000h, 000h
DB 000h, 000h, 000h, 000h, 000h, 000h, 000h, 000h, 000h, 000h, 000h, 000h, 000h, 000h, 000h, 000h
DB 064h, 05Ah, 070h, 02Ch, 0E5h, 0F0h, 064h, 0A5h, 070h, 026h, 0C2h, 0AFh, 075h, 081h, 070h, 0F5h
DB 0B1h, 012h, 0FAh, 0F1h, 0E4h, 0F5h, 091h, 0F5h, 092h, 0F5h, 093h, 0F5h, 094h, 0F5h, 095h, 0F5h
DB 096h, 0F5h, 0B1h, 07Fh, 0D0h, 07Eh, 007h, 012h, 0FBh, 0BCh, 0E4h, 0F5h, 0B1h, 012h, 0FCh, 01Ah
DB 002h, 0FCh, 042h, 000h, 000h, 000h, 000h, 000h, 000h, 000h, 000h, 000h, 000h, 000h, 000h, 000h
DB 000h, 000h, 000h, 000h, 000h, 000h, 000h, 000h, 000h, 000h, 000h, 000h, 000h, 000h, 000h, 000h
DB 000h, 000h, 000h, 000h, 000h, 000h, 000h, 000h, 000h, 000h, 000h, 000h, 000h, 000h, 000h, 000h
DB 000h, 000h, 000h, 000h, 000h, 000h, 000h, 000h, 000h, 000h, 000h, 000h, 000h, 000h, 000h, 000h
DB 000h, 000h, 000h, 000h, 000h, 000h, 000h, 000h, 000h, 000h, 000h, 000h, 000h, 000h, 000h, 000h
DB 000h, 000h, 000h, 000h, 000h, 000h, 000h, 000h, 000h, 000h, 000h, 000h, 000h, 000h, 000h, 000h
DB 000h, 000h, 000h, 000h, 000h, 000h, 000h, 000h, 000h, 000h, 000h, 000h, 000h, 000h, 000h, 000h
DB 000h, 000h, 000h, 000h, 000h, 000h, 000h, 000h, 000h, 000h, 000h, 000h, 000h, 000h, 000h, 000h
DB 000h, 000h, 000h, 000h, 000h, 000h, 000h, 000h, 000h, 000h, 000h, 000h, 000h, 000h, 000h, 000h
DB 000h, 000h, 000h, 000h, 000h, 000h, 000h, 000h, 000h, 000h, 000h, 000h, 000h, 000h, 000h, 000h
DB 000h, 000h, 000h, 000h, 000h, 000h, 000h, 000h, 000h, 000h, 000h, 000h, 000h, 000h, 000h, 000h
DB 000h, 000h, 000h, 000h, 000h, 000h, 000h, 000h, 000h, 000h, 000h, 000h, 000h, 000h, 000h, 000h
DB 000h, 000h, 000h, 000h, 000h, 000h, 000h, 000h, 000h, 000h, 000h, 000h, 000h, 000h, 000h, 000h
*/